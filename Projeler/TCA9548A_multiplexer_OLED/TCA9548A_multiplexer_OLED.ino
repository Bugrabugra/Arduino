#include <SPI.h>
#include <Wire.h>
#include <Adafruit_GFX.h>
#include <Adafruit_SSD1306.h>

#define SCREEN_WIDTH 128  // OLED display width, in pixels
#define SCREEN_HEIGHT 64  // OLED display height, in pixels

// Declaration for an SSD1306 display connected to I2C (SDA, SCL pins)
#define OLED_RESET 4  // Reset pin # (or -1 if sharing Arduino reset pin)

Adafruit_SSD1306 display(SCREEN_WIDTH, SCREEN_HEIGHT, &Wire, OLED_RESET);

#define MUX_Address 0x70  // TCA9548A Encoders address

const unsigned char summer[] PROGMEM = {
  0x00, 0x00, 0x00, 0x00, 0x00, 0x00, 0x60, 0x00, 0x00, 0x00, 0x00, 0x00, 0x00, 0x00, 0x78, 0x00,
  0x00, 0x00, 0x00, 0x00, 0x03, 0xFF, 0xF0, 0x00, 0x00, 0x00, 0x00, 0x00, 0x1F, 0xFF, 0xF0, 0x00,
  0x00, 0x00, 0x00, 0x00, 0x7F, 0xFF, 0xFC, 0x00, 0x00, 0x00, 0x00, 0x01, 0xFF, 0xFF, 0xFE, 0x00,
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  0x07, 0xFF, 0x00, 0x1F, 0xF8, 0x00, 0xFF, 0xC0, 0x01, 0xFC, 0x00, 0x07, 0xE0, 0x00, 0x3F, 0x00
};

const unsigned char very_funny[] PROGMEM = {
  0x00, 0x00, 0x00, 0x00, 0x00, 0x00, 0x00, 0x00, 0x00, 0x00, 0x00, 0x00, 0x00, 0x00, 0x00, 0x00,
  0x00, 0x00, 0x00, 0x00, 0x00, 0x00, 0x00, 0x00, 0x00, 0x00, 0x00, 0x00, 0x00, 0x00, 0x00, 0x00,
  0x00, 0x00, 0x00, 0x00, 0x00, 0x00, 0x00, 0x00, 0x00, 0x00, 0x00, 0x00, 0x00, 0x00, 0x00, 0x00,
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  0x00, 0x00, 0x00, 0x00, 0x00, 0x00, 0x00, 0x00, 0x00, 0x00, 0x00, 0x00, 0x00, 0x00, 0x00, 0x00
};
// Initialize I2C buses using TCA9548A I2C Multiplexer
void tcaselect(uint8_t i2c_bus) {
  if (i2c_bus > 7) return;
  Wire.beginTransmission(MUX_Address);
  Wire.write(1 << i2c_bus);
  Wire.endTransmission();
}


void setup() {
  DisplayInit();  // Initialize the displays
}


// Initialize the displays
void DisplayInit() {
  for (int i = 0; i < 7; i++) {
    tcaselect(i);  // Loop through each connected displays on the I2C buses
    display.begin(SSD1306_SWITCHCAPVCC, 0x3C);
  }
}

void loop() {
  for (int i = 0; i < 7; i++) {
    tcaselect(i);

    if (i == 0) {
      display.clearDisplay();
      display.setCursor(0, 0);
      display.drawBitmap(0, 1, very_funny, 64, 64, 1);
      display.display();
    }

    if (i == 1) {
      for (int b = 0; b < 10; b++) {
        display.clearDisplay();
        display.drawBitmap(0, 1, summer, 64, 64, 1);
        display.setCursor(60, 40);
        display.setTextSize(2);       // Normal 1:1 pixel scale
        display.setTextColor(WHITE);  // Draw white text
        display.cp437(true);          // Use full 256 char 'Code Page 437' font
        display.print(b);
        delay(1000);
        display.display();
      }
    }
  }
}
